## boards/shields/split_iceseed/Kconfig.defconfig
```kconfig
if SHIELD_SPLIT_ICESEED_LEFT

config ZMK_KEYBOARD_NAME
    default "split_iceseed"

endif

if SHIELD_SPLIT_ICESEED_LEFT || SHIELD_SPLIT_ICESEED_RIGHT

config ZMK_SPLIT
    default y

endif
```

## boards/shields/split_iceseed/Kconfig.shield
```kconfig
config SHIELD_SPLIT_ICESEED_LEFT
    def_bool $(shields_list_contains,split_iceseed_left)
config SHIELD_SPLIT_ICESEED_RIGHT
    def_bool $(shields_list_contains,split_iceseed_right)
```
